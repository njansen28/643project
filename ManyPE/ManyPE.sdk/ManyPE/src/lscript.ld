/*******************************************************************/
/*                                                                 */
/* This file is automatically generated by linker script generator.*/
/*                                                                 */
/* Version:                                 */
/*                                                                 */
/* Copyright (c) 2010 Xilinx, Inc.  All rights reserved.           */
/*                                                                 */
/* Description : Cortex-A9 Linker Script                          */
/*                                                                 */
/*******************************************************************/

_STACK_SIZE = DEFINED(_STACK_SIZE) ? _STACK_SIZE : 0x2000;
_HEAP_SIZE = DEFINED(_HEAP_SIZE) ? _HEAP_SIZE : 0x2000;

_ABORT_STACK_SIZE = DEFINED(_ABORT_STACK_SIZE) ? _ABORT_STACK_SIZE : 1024;
_SUPERVISOR_STACK_SIZE = DEFINED(_SUPERVISOR_STACK_SIZE) ? _SUPERVISOR_STACK_SIZE : 2048;
_IRQ_STACK_SIZE = DEFINED(_IRQ_STACK_SIZE) ? _IRQ_STACK_SIZE : 1024;
_FIQ_STACK_SIZE = DEFINED(_FIQ_STACK_SIZE) ? _FIQ_STACK_SIZE : 1024;
_UNDEF_STACK_SIZE = DEFINED(_UNDEF_STACK_SIZE) ? _UNDEF_STACK_SIZE : 1024;

/* Define Memories in the system */

MEMORY
{
   axi_bram_ctrl_0_S_AXI_BASEADDR : ORIGIN = 0x40000000, LENGTH = 0x00001000
   axi_bram_ctrl_1_S_AXI_BASEADDR : ORIGIN = 0x42000000, LENGTH = 0x00001000
   axi_bram_ctrl_2_S_AXI_BASEADDR : ORIGIN = 0x44000000, LENGTH = 0x00001000
   axi_bram_ctrl_3_S_AXI_BASEADDR : ORIGIN = 0x46000000, LENGTH = 0x00001000
   axi_bram_ctrl_4_S_AXI_BASEADDR : ORIGIN = 0x48000000, LENGTH = 0x00001000
   axi_bram_ctrl_5_S_AXI_BASEADDR : ORIGIN = 0x4A000000, LENGTH = 0x00001000
   axi_bram_ctrl_6_S_AXI_BASEADDR : ORIGIN = 0x4C000000, LENGTH = 0x00001000
   axi_bram_ctrl_7_S_AXI_BASEADDR : ORIGIN = 0x4E000000, LENGTH = 0x00001000
   axi_bram_ctrl_8_S_AXI_BASEADDR : ORIGIN = 0x50000000, LENGTH = 0x00001000
   axi_bram_ctrl_9_S_AXI_BASEADDR : ORIGIN = 0x52000000, LENGTH = 0x00001000
   axi_bram_ctrl_10_S_AXI_BASEADDR : ORIGIN = 0x54000000, LENGTH = 0x00001000
   axi_bram_ctrl_11_S_AXI_BASEADDR : ORIGIN = 0x56000000, LENGTH = 0x00001000
   axi_bram_ctrl_12_S_AXI_BASEADDR : ORIGIN = 0x58000000, LENGTH = 0x00001000
   axi_bram_ctrl_13_S_AXI_BASEADDR : ORIGIN = 0x5A000000, LENGTH = 0x00001000
   axi_bram_ctrl_14_S_AXI_BASEADDR : ORIGIN = 0x5C000000, LENGTH = 0x00001000
   axi_bram_ctrl_15_S_AXI_BASEADDR : ORIGIN = 0x5E000000, LENGTH = 0x00001000
   axi_bram_ctrl_16_S_AXI_BASEADDR : ORIGIN = 0x60000000, LENGTH = 0x00001000
   axi_bram_ctrl_17_S_AXI_BASEADDR : ORIGIN = 0x62000000, LENGTH = 0x00001000
   axi_bram_ctrl_18_S_AXI_BASEADDR : ORIGIN = 0x64000000, LENGTH = 0x00001000
   axi_bram_ctrl_19_S_AXI_BASEADDR : ORIGIN = 0x66000000, LENGTH = 0x00001000
   axi_bram_ctrl_20_S_AXI_BASEADDR : ORIGIN = 0x68000000, LENGTH = 0x00001000
   axi_bram_ctrl_21_S_AXI_BASEADDR : ORIGIN = 0x6A000000, LENGTH = 0x00001000
   axi_bram_ctrl_22_S_AXI_BASEADDR : ORIGIN = 0x6C000000, LENGTH = 0x00001000
   axi_bram_ctrl_23_S_AXI_BASEADDR : ORIGIN = 0x6E000000, LENGTH = 0x00001000
   axi_bram_ctrl_24_S_AXI_BASEADDR : ORIGIN = 0x70000000, LENGTH = 0x00001000
   axi_bram_ctrl_25_S_AXI_BASEADDR : ORIGIN = 0x72000000, LENGTH = 0x00001000
   axi_bram_ctrl_26_S_AXI_BASEADDR : ORIGIN = 0x74000000, LENGTH = 0x00001000
   axi_bram_ctrl_27_S_AXI_BASEADDR : ORIGIN = 0x76000000, LENGTH = 0x00001000
   axi_bram_ctrl_28_S_AXI_BASEADDR : ORIGIN = 0x78000000, LENGTH = 0x00001000
   axi_bram_ctrl_29_S_AXI_BASEADDR : ORIGIN = 0x7A000000, LENGTH = 0x00001000
   axi_bram_ctrl_30_S_AXI_BASEADDR : ORIGIN = 0x7C000000, LENGTH = 0x00001000
   axi_bram_ctrl_31_S_AXI_BASEADDR : ORIGIN = 0x7E000000, LENGTH = 0x00001000
   axi_bram_ctrl_32_S_AXI_BASEADDR : ORIGIN = 0x7E002000, LENGTH = 0x00001000
   axi_bram_ctrl_33_S_AXI_BASEADDR : ORIGIN = 0x7E004000, LENGTH = 0x00001000
   axi_bram_ctrl_34_S_AXI_BASEADDR : ORIGIN = 0x7E006000, LENGTH = 0x00001000
   axi_bram_ctrl_35_S_AXI_BASEADDR : ORIGIN = 0x7E008000, LENGTH = 0x00001000
   axi_bram_ctrl_36_S_AXI_BASEADDR : ORIGIN = 0x7E00A000, LENGTH = 0x00001000
   axi_bram_ctrl_37_S_AXI_BASEADDR : ORIGIN = 0x7E00C000, LENGTH = 0x00001000
   axi_bram_ctrl_38_S_AXI_BASEADDR : ORIGIN = 0x7E00E000, LENGTH = 0x00001000
   axi_bram_ctrl_39_S_AXI_BASEADDR : ORIGIN = 0x7E010000, LENGTH = 0x00001000
   axi_bram_ctrl_40_S_AXI_BASEADDR : ORIGIN = 0x7E012000, LENGTH = 0x00001000
   axi_bram_ctrl_41_S_AXI_BASEADDR : ORIGIN = 0x7E014000, LENGTH = 0x00001000
   axi_bram_ctrl_42_S_AXI_BASEADDR : ORIGIN = 0x7E016000, LENGTH = 0x00001000
   axi_bram_ctrl_43_S_AXI_BASEADDR : ORIGIN = 0x7E018000, LENGTH = 0x00001000
   axi_bram_ctrl_44_S_AXI_BASEADDR : ORIGIN = 0x7E01A000, LENGTH = 0x00001000
   axi_bram_ctrl_45_S_AXI_BASEADDR : ORIGIN = 0x7E01C000, LENGTH = 0x00001000
   axi_bram_ctrl_46_S_AXI_BASEADDR : ORIGIN = 0x7E01E000, LENGTH = 0x00001000
   axi_bram_ctrl_47_S_AXI_BASEADDR : ORIGIN = 0x7E020000, LENGTH = 0x00001000
   axi_bram_ctrl_48_S_AXI_BASEADDR : ORIGIN = 0x7E022000, LENGTH = 0x00001000
   axi_bram_ctrl_49_S_AXI_BASEADDR : ORIGIN = 0x7E024000, LENGTH = 0x00001000
   ps7_ddr_0_S_AXI_BASEADDR : ORIGIN = 0x00100000, LENGTH = 0x1FF00000
   ps7_ram_0_S_AXI_BASEADDR : ORIGIN = 0x00000000, LENGTH = 0x00030000
   ps7_ram_1_S_AXI_BASEADDR : ORIGIN = 0xFFFF0000, LENGTH = 0x0000FE00
}

/* Specify the default entry point to the program */

ENTRY(_vector_table)

/* Define the sections, and where they are mapped in memory */

SECTIONS
{
.text : {
   KEEP (*(.vectors))
   *(.boot)
   *(.text)
   *(.text.*)
   *(.gnu.linkonce.t.*)
   *(.plt)
   *(.gnu_warning)
   *(.gcc_execpt_table)
   *(.glue_7)
   *(.glue_7t)
   *(.vfp11_veneer)
   *(.ARM.extab)
   *(.gnu.linkonce.armextab.*)
} > ps7_ddr_0_S_AXI_BASEADDR

.init : {
   KEEP (*(.init))
} > ps7_ddr_0_S_AXI_BASEADDR

.fini : {
   KEEP (*(.fini))
} > ps7_ddr_0_S_AXI_BASEADDR

.rodata : {
   __rodata_start = .;
   *(.rodata)
   *(.rodata.*)
   *(.gnu.linkonce.r.*)
   __rodata_end = .;
} > ps7_ddr_0_S_AXI_BASEADDR

.rodata1 : {
   __rodata1_start = .;
   *(.rodata1)
   *(.rodata1.*)
   __rodata1_end = .;
} > ps7_ddr_0_S_AXI_BASEADDR

.sdata2 : {
   __sdata2_start = .;
   *(.sdata2)
   *(.sdata2.*)
   *(.gnu.linkonce.s2.*)
   __sdata2_end = .;
} > ps7_ddr_0_S_AXI_BASEADDR

.sbss2 : {
   __sbss2_start = .;
   *(.sbss2)
   *(.sbss2.*)
   *(.gnu.linkonce.sb2.*)
   __sbss2_end = .;
} > ps7_ddr_0_S_AXI_BASEADDR

.data : {
   __data_start = .;
   *(.data)
   *(.data.*)
   *(.gnu.linkonce.d.*)
   *(.jcr)
   *(.got)
   *(.got.plt)
   __data_end = .;
} > ps7_ddr_0_S_AXI_BASEADDR

.data1 : {
   __data1_start = .;
   *(.data1)
   *(.data1.*)
   __data1_end = .;
} > ps7_ddr_0_S_AXI_BASEADDR

.got : {
   *(.got)
} > ps7_ddr_0_S_AXI_BASEADDR

.ctors : {
   __CTOR_LIST__ = .;
   ___CTORS_LIST___ = .;
   KEEP (*crtbegin.o(.ctors))
   KEEP (*(EXCLUDE_FILE(*crtend.o) .ctors))
   KEEP (*(SORT(.ctors.*)))
   KEEP (*(.ctors))
   __CTOR_END__ = .;
   ___CTORS_END___ = .;
} > ps7_ddr_0_S_AXI_BASEADDR

.dtors : {
   __DTOR_LIST__ = .;
   ___DTORS_LIST___ = .;
   KEEP (*crtbegin.o(.dtors))
   KEEP (*(EXCLUDE_FILE(*crtend.o) .dtors))
   KEEP (*(SORT(.dtors.*)))
   KEEP (*(.dtors))
   __DTOR_END__ = .;
   ___DTORS_END___ = .;
} > ps7_ddr_0_S_AXI_BASEADDR

.fixup : {
   __fixup_start = .;
   *(.fixup)
   __fixup_end = .;
} > ps7_ddr_0_S_AXI_BASEADDR

.eh_frame : {
   *(.eh_frame)
} > ps7_ddr_0_S_AXI_BASEADDR

.eh_framehdr : {
   __eh_framehdr_start = .;
   *(.eh_framehdr)
   __eh_framehdr_end = .;
} > ps7_ddr_0_S_AXI_BASEADDR

.gcc_except_table : {
   *(.gcc_except_table)
} > ps7_ddr_0_S_AXI_BASEADDR

.mmu_tbl (ALIGN(16384)) : {
   __mmu_tbl_start = .;
   *(.mmu_tbl)
   __mmu_tbl_end = .;
} > ps7_ddr_0_S_AXI_BASEADDR

.ARM.exidx : {
   __exidx_start = .;
   *(.ARM.exidx*)
   *(.gnu.linkonce.armexidix.*.*)
   __exidx_end = .;
} > ps7_ddr_0_S_AXI_BASEADDR

.preinit_array : {
   __preinit_array_start = .;
   KEEP (*(SORT(.preinit_array.*)))
   KEEP (*(.preinit_array))
   __preinit_array_end = .;
} > ps7_ddr_0_S_AXI_BASEADDR

.init_array : {
   __init_array_start = .;
   KEEP (*(SORT(.init_array.*)))
   KEEP (*(.init_array))
   __init_array_end = .;
} > ps7_ddr_0_S_AXI_BASEADDR

.fini_array : {
   __fini_array_start = .;
   KEEP (*(SORT(.fini_array.*)))
   KEEP (*(.fini_array))
   __fini_array_end = .;
} > ps7_ddr_0_S_AXI_BASEADDR

.ARM.attributes : {
   __ARM.attributes_start = .;
   *(.ARM.attributes)
   __ARM.attributes_end = .;
} > ps7_ddr_0_S_AXI_BASEADDR

.sdata : {
   __sdata_start = .;
   *(.sdata)
   *(.sdata.*)
   *(.gnu.linkonce.s.*)
   __sdata_end = .;
} > ps7_ddr_0_S_AXI_BASEADDR

.sbss (NOLOAD) : {
   __sbss_start = .;
   *(.sbss)
   *(.sbss.*)
   *(.gnu.linkonce.sb.*)
   __sbss_end = .;
} > ps7_ddr_0_S_AXI_BASEADDR

.tdata : {
   __tdata_start = .;
   *(.tdata)
   *(.tdata.*)
   *(.gnu.linkonce.td.*)
   __tdata_end = .;
} > ps7_ddr_0_S_AXI_BASEADDR

.tbss : {
   __tbss_start = .;
   *(.tbss)
   *(.tbss.*)
   *(.gnu.linkonce.tb.*)
   __tbss_end = .;
} > ps7_ddr_0_S_AXI_BASEADDR

.bss (NOLOAD) : {
   __bss_start = .;
   *(.bss)
   *(.bss.*)
   *(.gnu.linkonce.b.*)
   *(COMMON)
   __bss_end = .;
} > ps7_ddr_0_S_AXI_BASEADDR

_SDA_BASE_ = __sdata_start + ((__sbss_end - __sdata_start) / 2 );

_SDA2_BASE_ = __sdata2_start + ((__sbss2_end - __sdata2_start) / 2 );

/* Generate Stack and Heap definitions */

.heap (NOLOAD) : {
   . = ALIGN(16);
   _heap = .;
   HeapBase = .;
   _heap_start = .;
   . += _HEAP_SIZE;
   _heap_end = .;
   HeapLimit = .;
} > ps7_ddr_0_S_AXI_BASEADDR

.stack (NOLOAD) : {
   . = ALIGN(16);
   _stack_end = .;
   . += _STACK_SIZE;
   . = ALIGN(16);
   _stack = .;
   __stack = _stack;
   . = ALIGN(16);
   _irq_stack_end = .;
   . += _IRQ_STACK_SIZE;
   . = ALIGN(16);
   __irq_stack = .;
   _supervisor_stack_end = .;
   . += _SUPERVISOR_STACK_SIZE;
   . = ALIGN(16);
   __supervisor_stack = .;
   _abort_stack_end = .;
   . += _ABORT_STACK_SIZE;
   . = ALIGN(16);
   __abort_stack = .;
   _fiq_stack_end = .;
   . += _FIQ_STACK_SIZE;
   . = ALIGN(16);
   __fiq_stack = .;
   _undef_stack_end = .;
   . += _UNDEF_STACK_SIZE;
   . = ALIGN(16);
   __undef_stack = .;
} > ps7_ddr_0_S_AXI_BASEADDR

_end = .;
}

